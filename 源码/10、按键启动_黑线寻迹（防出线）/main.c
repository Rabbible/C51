/*********************************************************************************
* 【编写时间】： 2016年12月2日
* 【作    者】： 清翔电子:03
* 【版    本】： 1.0
* 【网    站】： http://www.qxmcu.com/ 
* 【淘宝店铺】： http://qxmcu.taobao.com/ (直销店)
* 【实验平台】： QX-MCS51 单片机开发板 & QX-A51智能小车
* 【外部晶振】： 11.0592mhz	
* 【主控芯片】： STC89C52
* 【编译环境】： Keil μVisio4
* ********************************【接线说明】********************************
             以下"A_"表示智能小车底板~~~"B_"表示开发板     
*开发板供电线  ：A_J5-VCC~~~B_VCC或5V0    A_J6-GND~~~B_GND （一共使用2根杜邦线）
*电机控制线    ：A_J10-P1.2至P1.7 对应接到B_P1.2至P1.7 （一共使用6根杜邦线）
*避障寻迹反馈线：A_J11-P3.2至P3.5 对应接到B_P3.2至P3.5 （一共使用4根杜邦线）
******************************************************************************
* 【程序功能】：QX-A51智能小车按键启动_黑线寻迹（防出线）		   			            			    
* 【使用说明】：接线无误后，烧写程序打开电源开关、按下S2按键后蜂鸣器发出提示音1秒
				后启动小车黑线寻迹（防出线）
* 【注意事项】：避免小车撞向障碍物或小车轮子堵转，小车电压不能低于6V
				1、不能在自然光强烈的条件下进行试验
				2、进行试验前必须调节好寻迹探头
				3、必须先搭建好实验环境（参考相关视频教程）
				4、此程序只做参考，实际运行效果需根据不同实验场地进行不同调试
**********************************************************************************/
#include <reg52.h> //51头文件
#include <..\CONFIG\QXA51.h>//QX-A51智能小车配置文件
unsigned char pwm_left_val = 150;//左电机占空比值 取值范围0-170，0最快
unsigned char pwm_right_val = 150;//右电机占空比值取值范围0-170 ,0最快
unsigned char pwm_t;//周期

void delay(unsigned int z)//毫秒级延时
{
	unsigned int x,y;
	for(x = z; x > 0; x--)
		for(y = 114; y > 0 ; y--);
}	
/*小车前进*/
void forward()
{
	left_motor_go; //左电机前进
	right_motor_go; //右电机前进
}
/*小车左转*/
void left_run()
{
	left_motor_stops; //左电机停止
	right_motor_go; //右电机前进	
}
/*小车右转*/
void right_run()
{
	right_motor_stops;//右电机停止
	left_motor_go;    //左电机前进
}
/*小车后退*/
void backward()
{
	left_motor_back; //左电机后退
	right_motor_back; //右电机后退	
}

//定时器0中断
void timer0() interrupt 1
{
	pwm_t++;//周期计时加
	if(pwm_t == 255)
		pwm_t = EN1 = EN2 = 0;
	if(pwm_left_val == pwm_t)//左电机占空比	
		EN1 = 1;		
	if(pwm_right_val == pwm_t)//右电机占空比
		EN2 = 1;			 
}
void main()
{
	for(;;)	//死循环
	{
		if(key_s2 == 0)// 实时检测S2按键是否被按下
		{
			delay(5); //软件消抖
			if(key_s2 == 0)//再检测S2是否被按下
			{
				while(!key_s2);//松手检测
				beep = 0;	//使能有源蜂鸣器
				delay(200);//200毫秒延时
				beep = 1;	//关闭有源蜂鸣器
				break;		//退出FOR死循环
			}
		}
	}
	delay(1000);//延时1秒
	TMOD |= 0x02;//8位自动重装模块
	TH0 = 220;
	TL0 = 220;//11.0592M晶振下占空比最大比值是256,输出100HZ
	TR0 = 1;//启动定时器0
	ET0 = 1;//允许定时器0中断
	EA	= 1;//总中断允许
	while(1)
	{
		//为0 没有识别到黑线 为1识别到黑线
		if(left_led1 == 1 && right_led1 == 1)//左右寻迹探头识别到黑线
		{
			forward();//前进
		}
		else
		{
			if(left_led1 == 1 && right_led1 == 0)//小车右边出线，左转修正
			{
				left_run();//左转
			}
			if(left_led1 == 0 && right_led1 == 1)//小车左边出线，右转修正
			{
				right_run();//右转
			}
			if(left_led1 == 0 && right_led1 == 0)//左右寻迹探头都没识别到黑线
			{
				backward();//后退
			}		
		}		
	}
}