/*********************************************************************************
* 【编写时间】： 2016年12月2日
* 【作    者】： 清翔电子:03
* 【版    本】： 1.0
* 【网    站】： http://www.qxmcu.com/ 
* 【淘宝店铺】： http://qxmcu.taobao.com/ (直销店)
* 【实验平台】： QX-MCS51 单片机开发板 & QX-A51智能小车
* 【外部晶振】： 11.0592mhz	
* 【主控芯片】： STC89C52
* 【编译环境】： Keil μVisio4
* ********************************【接线说明】********************************
             以下"A_"表示智能小车底板~~~"B_"表示开发板     
*开发板供电线  ：A_J5-VCC~~~B_VCC或5V0    A_J6-GND~~~B_GND （一共使用2根杜邦线）
*电机控制线    ：A_J10-P1.2至P1.7 对应接到B_P1.2至P1.7 （一共使用6根杜邦线）
*避障寻迹反馈线：A_J11-P3.2至P3.5 对应接到B_P3.2至P3.5 （一共使用4根杜邦线）
******************************************************************************
* 【程序功能】：按键调节LED灯亮度20级调光		   			            			    
* 【使用说明】：接线无误后，烧写程序打开电源开关，按S2按键LED灯光变弱、按S3按键LED光变亮
* 【注意事项】：P1口不能接任何设备，不能接杜邦线。
				J9跳线帽必须接上。
**********************************************************************************/

#include <reg52.h>
#include <..\CONFIG\QXA51.h>
unsigned char pwm_led_val = 0;//LED占空比值 0-20 0最亮
unsigned char pwm_t;//周期

void delay(unsigned int z)//毫秒级延时
{
	unsigned int x,y;
	for(x = z; x > 0; x--)
		for(y = 114; y > 0 ; y--);
}	

//定时器0中断
void timer0() interrupt 1
{
	pwm_t++;
	if(pwm_t == 20)
	{
		pwm_t = 0; P1 = 0xff;
	}
	if(pwm_led_val == pwm_t)
		P1 = 0;					 
}
void main()
{
	TMOD |= 0x02;//8位自动重装模块
	TH0 = 240;
	TL0 = 240;//11.0592M晶振下占空比最大比值是20,输出2880HZ
	TR0 = 1;//启动定时器0
	ET0 = 1;//允许定时器0中断
	EA	= 1;//总中断允许
	while(1)
	{
		if(key_s2 == 0)	 //S2按下LED变暗
		{
			delay(5);
			if(key_s2 == 0)
			{
				if(pwm_led_val < 20)
				{
					pwm_led_val++;
				}
				while(!key_s2);
			}
		}
		if(key_s3 == 0)	//S3按键LED变亮
		{
			delay(5);
			if(key_s3 == 0)
			{
				if(pwm_led_val > 0)
				{
					pwm_led_val--;
				}
				while(!key_s3);
			}
		}		
	}
}