/*********************************************************************************
* 【编写时间】： 2016年12月2日
* 【作    者】： 清翔电子:03
* 【版    本】： 1.0
* 【网    站】： http://www.qxmcu.com/ 
* 【淘宝店铺】： http://qxmcu.taobao.com/ (直销店)
* 【实验平台】： QX-MCS51 单片机开发板 & QX-A51智能小车
* 【外部晶振】： 11.0592mhz	
* 【主控芯片】： STC89C52
* 【编译环境】： Keil μVisio4
* ********************************【接线说明】********************************
             以下"A_"表示智能小车底板~~~"B_"表示开发板     
*开发板供电线  ：A_J5-VCC~~~B_VCC或5V0    A_J6-GND~~~B_GND （一共使用2根杜邦线）
*电机控制线    ：A_J10-P1.2至P1.7 对应接到B_P1.2至P1.7 （一共使用6根杜邦线）
*避障寻迹反馈线：A_J11-P3.2至P3.5 对应接到B_P3.2至P3.5 （一共使用4根杜邦线）
******************************************************************************
* 【程序功能】：QX-A51智能小车PWM调速		   			            			    
* 【使用说明】：接线无误后，烧写程序打开电源开关小车低速前进，调节程序可以调节小车速度
* 【注意事项】：避免小车撞向障碍物或小车轮子堵转，小车电压不能低于6V
**********************************************************************************/
#include <reg52.h>
#include <..\CONFIG\QXA51.h>
unsigned char pwm_left_val = 210;//左电机占空比值 取值范围0-170，0最快
unsigned char pwm_right_val = 210;//右电机占空比值取值范围0-170 ,0最快
unsigned char pwm_t;//周期
/*小车前进*/
void forward()
{
	left_motor_go; //左电机前进
	right_motor_go; //右电机前进
}

//定时器0中断
void timer0() interrupt 1
{
	pwm_t++;
	if(pwm_t == 255)
		pwm_t = EN1 = EN2 = 0;
	if(pwm_left_val == pwm_t)
		EN1 = 1;		
	if(pwm_right_val == pwm_t)
		EN2 = 1;			 
}
void main()
{
	TMOD |= 0x02;//8位自动重装模块
	TH0 = 220;
	TL0 = 220;//11.0592M晶振下占空比最大比值是256,输出100HZ
	TR0 = 1;//启动定时器0
	ET0 = 1;//允许定时器0中断
	EA	= 1;//总中断允许
	while(1)
	{
		forward();//前进		
	}
}